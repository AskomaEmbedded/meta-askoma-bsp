## conf/layer.conf
```bitbake
# We have a conf and classes directory, add to BBPATH
BBPATH .= ":${LAYERDIR}"

# We have recipes-* directories, add to BBFILES
BBFILES += "${LAYERDIR}/recipes-*/*/*.bb \
            ${LAYERDIR}/recipes-*/*/*.bbappend"

BBFILE_COLLECTIONS += "askoma-bsp"
BBFILE_PATTERN_askoma-bsp = "^${LAYERDIR}/"
BBFILE_PRIORITY_askoma-bsp = "9"

LAYERDEPENDS_askoma-bsp = "freescale-layer"
LAYERSERIES_COMPAT_askoma-bsp = "kirkstone"
```

## conf/machine/imx6ull-em-r1.conf
```bitbake
#@TYPE: Machine
#@NAME: ENERGY MANAGER BASED IN IMX6ULL
#@SOC: i.MX6ULL
#@DESCRIPTION: Machine configuration for Energy Manager 1.2 and 1.3 boards

MACHINEOVERRIDES =. "mx6ul:"

include conf/machine/include/imx-base.inc
include conf/machine/include/tune-cortexa7.inc

IMX_DEFAULT_BSP = "mainline"

PREFERRED_PROVIDER_virtual/kernel ?= "linux-askoma"
PREFERRED_PROVIDER_u-boot ?= "u-boot-askoma"
PREFERRED_PROVIDER_virtual/bootloader ?= "u-boot-askoma"
PREFERRED_VERSION_u-boot-askoma = "2020%"
PREFERRED_PROVIDER_u-boot-default-script ??= "u-boot-script-askoma"

KERNEL_CLASSES ?= " kernel-fitimage "
KERNEL_IMAGETYPES ?= "fitImage"
KERNEL_DEVICETREE = " \
    imx6ull-em-rev1.2.dtb \
    imx6ull-em-rev1.3.dtb \
"

SERIAL_CONSOLES = "115200;ttymxc3"

UBOOT_CONFIG = "askoma-mx6ul"
UBOOT_CONFIG[askoma-mx6ul] = "askoma_mx6ul_defconfig"

SPL_BINARY = "SPL"
UBOOT_ENTRYPOINT = "0x81000000"
UBOOT_MAKE_TARGET = ""
UBOOT_SUFFIX = "img"
UBOOT_BINARY = "u-boot.${UBOOT_SUFFIX}"

WKS_FILES ?= "imx-uboot-spl.wks.in"

# Deploy only fitimage and dtb files in /boot
RDEPENDS:${KERNEL_PACKAGE_NAME}-base = ""
MACHINE_ESSENTIAL_EXTRA_RDEPENDS ??= "kernel-image-fitimage u-boot-default-script"
MACHINE_EXTRA_RRECOMMENDS = "kernel-module-imx-sdma"

MACHINE_FEATURES = "rtc"
IMAGE_FSTYPES = "ubi wic.gz wic.bmap"

## NAND 512MB
MKUBIFS_ARGS = "-F -m 4096 -e 253952 -c 950 -x favor_lzo -X 5"
MKUBIFS_ARGS_INTERNAL = "-F -m 4096 -e 253952 -c 100 -x favor_lzo -X 5"
UBINIZE_ARGS = "-m 4096 -p 262144 -s 4096"
UBI_VOLNAME = "boot"
```

## conf/machine/imx8mm-em-r1.conf
```bitbake
#@TYPE: Machine
#@NAME: ENERGY MANAGER BASED IN IMX8MM 
#@SOC: i.MX8MM
#@DESCRIPTION: Machine configuration for Energy Manager 2.0 board

MACHINEOVERRIDES =. "imx-boot-container:mx8:mx8m:mx8mm:"

require conf/machine/include/imx-base.inc
require conf/machine/include/arm/armv8a/tune-cortexa53.inc

IMX_DEFAULT_BSP = "mainline"

USE_VT = "0"

MACHINE_FEATURES = " \
    bluetooth \
    usbhost \
    wifi \
"

MACHINE_ESSENTIAL_EXTRA_RDEPENDS ?= "u-boot-default-script"
MACHINE_ESSENTIAL_EXTRA_RRECOMMENDS += "\
    kernel-image \
    kernel-devicetree \
"

PREFERRED_PROVIDER_virtual/kernel ?= "linux-askoma"
KERNEL_DEVICETREE = "freescale/imx8mm-energy-manager.dtb"

PREFERRED_PROVIDER_u-boot ?= "u-boot-askoma"
PREFERRED_PROVIDER_virtual/bootloader ?= "u-boot-askoma"
PREFERRED_VERSION_u-boot-askoma = "2022%"
PREFERRED_PROVIDER_u-boot-default-script ?= "u-boot-script-askoma"

ATF_PLATFORM = "imx8mm"
ATF_BOOT_UART_BASE = "0x30880000"

IMX_DEFAULT_ATF_PROVIDER = "imx-atf"
IMX_EXTRA_FIRMWARE = "firmware-imx-8m"

UBOOT_DTB_NAME = "imx8mm-kontron-n801x-s.dtb"

SPL_BINARY = "spl/u-boot-spl.bin"
UBOOT_SUFFIX = "bin"
UBOOT_CONFIG = "emmc"
UBOOT_CONFIG[emmc] = "kontron-sl-mx8mm_defconfig,emmc"
UBOOT_BINARY = "flash.bin"
UBOOT_DTB_LOADADDRESS = "0x50000000"

WKS_FILES ?= "imx-imx-boot.wks.in"

DDR_FIRMWARE_NAME = " \
    lpddr4_pmu_train_1d_imem.bin \
    lpddr4_pmu_train_1d_dmem.bin \
    lpddr4_pmu_train_2d_imem.bin \
    lpddr4_pmu_train_2d_dmem.bin \
"

# Talvez não precise
IMXBOOT_TARGETS_BASENAME = "flash_evk" 

# Set Serial console
SERIAL_CONSOLES = "115200;ttymxc0"

IMAGE_BOOT_FILES = "boot.scr-${MACHINE};boot.scr"

IMAGE_FSTYPES = "tar.xz wic.xz wic.bmap"

UBOOT_MAKE_TARGET = "all"
IMX_BOOT_SEEK = "33"

TEE_LOAD_ADDR = "0xbe000000"
```
